## config/west.yml
```yaml
manifest:
  remotes:
    - name: zmkfirmware
      url-base: https://github.com/ReFil
  projects:
    - name: zmk
      remote: zmkfirmware
      revision: form-devel-3
      import: app/west.yml
  self:
    path: config
```
